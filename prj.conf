## CMakeLists.txt
```
#
# Copyright (c) 2018 Nordic Semiconductor
#
# SPDX-License-Identifier: LicenseRef-Nordic-5-Clause
#
cmake_minimum_required(VERSION 3.20.0)

find_package(Zephyr REQUIRED HINTS $ENV{ZEPHYR_BASE})
project(peripheral_includedServices)

# NORDIC SDK APP START
target_sources(app PRIVATE
  src/main.c
)

target_sources(app PRIVATE src/local_ble.c)
target_sources(app PRIVATE src/local_lbs.c)
target_sources(app PRIVATE src/my_function.c)

# NORDIC SDK APP END
```

## Kconfig
```
#
# Copyright (c) 2018 Nordic Semiconductor
#
# SPDX-License-Identifier: LicenseRef-Nordic-5-Clause
#

source "Kconfig.zephyr"

menu "Nordic LED-Button BLE GATT service sample"

config MY_FUNCTION
	bool "Enable my function"
	default y

config BT_LBS_SECURITY_ENABLED
	bool "Enable security"
	default y
	select BT_SMP
	select BT_SETTINGS
	select FLASH
	select FLASH_PAGE_LAYOUT
	select FLASH_MAP
	select ZMS if (SOC_FLASH_NRF_RRAM || SOC_FLASH_NRF_MRAM)
	select NVS if !(SOC_FLASH_NRF_RRAM || SOC_FLASH_NRF_MRAM)
	select SETTINGS
	help
	  "Enable BLE security for the LED-Button service"

endmenu
```

## prj.conf
```kconfig
#
# Copyright (c) 2018 Nordic Semiconductor
#
# SPDX-License-Identifier: LicenseRef-Nordic-5-Clause
#
CONFIG_NCS_SAMPLES_DEFAULTS=y

CONFIG_BT=y
CONFIG_BT_PERIPHERAL=y
CONFIG_BT_DEVICE_NAME="Included_Peripheral"
CONFIG_FPU=y

CONFIG_BT_USER_DATA_LEN_UPDATE=y
CONFIG_BT_CTLR_PHY_2M=y
CONFIG_BT_USER_PHY_UPDATE=y

# CONFIG_BT_CTLR_DATA_LENGTH_MAX=251
CONFIG_BT_BUF_ACL_RX_SIZE=251
CONFIG_BT_BUF_ACL_TX_SIZE=251
CONFIG_BT_L2CAP_TX_MTU=247

# Add LBS service
CONFIG_DK_LIBRARY=y

CONFIG_LOG=y
# CONFIG_LOG_MODE_IMMEDIATE=y
# CONFIG_LOG_DEFAULT_LEVEL=4

CONFIG_SYSTEM_WORKQUEUE_STACK_SIZE=2048
CONFIG_MAIN_STACK_SIZE=2048
```

## src/main.c
```c
/*
 * Copyright (c) 2018 Nordic Semiconductor ASA
 *
 * SPDX-License-Identifier: LicenseRef-Nordic-5-Clause
 */

#include <zephyr/types.h>
#include <stddef.h>
#include <string.h>
#include <errno.h>
#include <zephyr/sys/byteorder.h>

#include <zephyr/bluetooth/bluetooth.h>
#include <zephyr/logging/log.h>
#include <zephyr/bluetooth/addr.h>
#include <zephyr/bluetooth/hci.h>
#include <zephyr/bluetooth/conn.h>
#include <zephyr/bluetooth/uuid.h>
#include <zephyr/bluetooth/gatt.h>
#include <zephyr/settings/settings.h>
#include <dk_buttons_and_leds.h>

#include "local_ble.h"
#include "local_lbs.h"
#include "my_function.h"

#define DEVICE_NAME             CONFIG_BT_DEVICE_NAME
#define DEVICE_NAME_LEN         (sizeof(DEVICE_NAME) - 1)
#define COMPANY_ID_CODE 		0x0059

#define RUN_STATUS_LED          DK_LED1
#define CON_STATUS_LED          DK_LED2
#define RUN_LED_BLINK_INTERVAL  1000

#define USER_LED                DK_LED3
#define USER_BUTTON             DK_BTN1_MSK

LOG_MODULE_REGISTER(Nordic_Peripheral, LOG_LEVEL_INF);

static bool app_button_state;
static int secondaryState;
static struct k_work adv_work;

static const struct bt_le_adv_param *adv_param = BT_LE_ADV_PARAM((BT_LE_ADV_OPT_CONN|BT_LE_ADV_OPT_USE_IDENTITY), 
                800, /*Min Advertising Interval 500ms (800*0.625ms) */
                801, /*Max Advertising Interval 500.625ms (801*0.625ms)*/
                NULL); /* Set to NULL for undirected advertising*/

typedef struct adv_mfg_data {
	uint16_t company_code; /* Company Identifier Code. */
	uint16_t number_press; /* Number of times Button 1 is pressed */
} adv_mfg_data_type;

static adv_mfg_data_type adv_mfg_data = { COMPANY_ID_CODE, 0x00 };
static struct bt_gatt_exchange_params exchange_params;

static const struct bt_data ad[] = {
	BT_DATA_BYTES(BT_DATA_FLAGS, (BT_LE_AD_GENERAL | BT_LE_AD_NO_BREDR)),
	BT_DATA(BT_DATA_NAME_COMPLETE, DEVICE_NAME, DEVICE_NAME_LEN),
	BT_DATA(BT_DATA_MANUFACTURER_DATA, (unsigned char *)&adv_mfg_data, sizeof(adv_mfg_data)),
};

static struct bt_conn *my_conn;

static const struct bt_data sd[] = {
	BT_DATA_BYTES(BT_DATA_UUID128_ALL, BT_UUID_LBS_VAL),
};

static void adv_work_handler(struct k_work *work) {
	int err = bt_le_adv_start(adv_param, ad, ARRAY_SIZE(ad), sd, ARRAY_SIZE(sd));
	if (err) {
		LOG_ERR("Advertising failed to start (err %d)", err);
		return;
	}

	LOG_INF("Advertising successfully started");
}

static void advertising_start(void) {
	k_work_submit(&adv_work);
}

static void app_led_cb(bool led_state) {
	dk_set_led(USER_LED, led_state);
}

static bool app_button_cb(void) {
	return app_button_state;
}

static struct my_lbs_cb app_callbacks = {
	.led_cb    = app_led_cb,
	.button_cb = app_button_cb,
};

static void button_changed(uint32_t button_state, uint32_t has_changed) {
	int err;
	if (has_changed & USER_BUTTON) {
		adv_mfg_data.number_press += 1;
		bt_le_adv_update_data(ad, ARRAY_SIZE(ad), sd, ARRAY_SIZE(sd));

		uint32_t user_button_state = button_state & USER_BUTTON;
		LOG_INF("Button %s", (user_button_state ? "Pressed" : "Released"));
		// err = bt_lbs_send_button_state(user_button_state);
		// if (err) {
		// 	LOG_ERR("Couldn't send notification. (err: %d)", err);
		// }
		button_state = user_button_state ? true : false;
	}
}

static void connected(struct bt_conn *conn, uint8_t err) {
	if (err) {
		LOG_ERR("Connection failed, err 0x%02x %s", err, bt_hci_err_to_str(err));
		return;
	}

	LOG_INF("Connected");
	my_conn = bt_conn_ref(conn);
	dk_set_led_on(CON_STATUS_LED);

	connectionParametersUpdated(conn, err);

	k_sleep(K_MSEC(1000));  // Delay added to avoid link layer collisions.
	updatePHY(conn);

	k_sleep(K_MSEC(1000));  // Delay added to avoid link layer collisions.
	updateDataLength(conn);
}

static void disconnected(struct bt_conn *conn, uint8_t reason) {
	LOG_INF("Disconnected, reason 0x%02x %s", reason, bt_hci_err_to_str(reason));
	bt_conn_unref(conn);
	dk_set_led_off(CON_STATUS_LED);
}

static void recycled_cb(void) {
	LOG_INF("Connection object available from previous conn. Disconnect is complete!");
	advertising_start();
}

BT_CONN_CB_DEFINE(conn_callbacks) = {
	.connected           = connected,
	.disconnected        = disconnected,
	.recycled            = recycled_cb,
	.le_param_updated    = connectionParametersUpdated,
	.le_phy_updated      = onLEphyUpdated,
	.le_data_len_updated = onLEdataLengthUpdated,
};

static int init_button(void) {
	int err = dk_buttons_init(button_changed);
	if (err) {
		LOG_ERR("Cannot init buttons (err: %d)", err);
	}

	return err;
}

static int secondary_read_cb(void) {
	secondaryState++;
	return secondaryState;
}

static struct secondary_service_cb secondary_callbacks = {
	.sec_cb = secondary_read_cb,
};

int main(void) {
	int blink_status = 0;
	int err;

	LOG_INF("Starting Bluetooth Peripheral LBS sample");

	err = dk_leds_init();
	if (err) {
		LOG_ERR("LEDs init failed (err %d)", err);
		return 0;
	}

	err = init_button();
	if (err) {
		LOG_ERR("Button init failed (err %d)", err);
		return 0;
	}

	err = bt_enable(NULL);
	if (err) {
		LOG_ERR("Bluetooth init failed (err %d)", err);
		return 0;
	}

	if (IS_ENABLED(CONFIG_SETTINGS)) {
		settings_load();
	}

	// bt_conn_cb_register(&connection_callbacks);

	err = my_lbs_init(&app_callbacks);
	if (err) {
		LOG_ERR("Failed to init LBS (err: %d)", err);
		return -1;
	}

	err = ble_sec_init(&secondary_callbacks);
	if (err) {
		LOG_ERR("Failed to init Secondary Service Callbacks (err: %d)", err);
		return -1;
	}

	LOG_INF("Bluetooth initialized");

	k_work_init(&adv_work, adv_work_handler);
	advertising_start();

	for (;;) {
		dk_set_led(RUN_STATUS_LED, (++blink_status) % 2);
		k_sleep(K_MSEC(RUN_LED_BLINK_INTERVAL));
	}
}
```

## src/local_ble.c
```c
#include <zephyr/types.h>
#include <stddef.h>
#include <string.h>
#include <errno.h>
#include <zephyr/sys/printk.h>
#include <zephyr/sys/byteorder.h>
#include <zephyr/kernel.h>
#include <zephyr/logging/log.h>

#include <zephyr/bluetooth/bluetooth.h>
#include <zephyr/bluetooth/hci.h>
#include <zephyr/bluetooth/conn.h>
#include <zephyr/bluetooth/uuid.h>
#include <zephyr/bluetooth/gatt.h>
#include <dk_buttons_and_leds.h>

#include "local_ble.h"

LOG_MODULE_DECLARE(Local_BLE);

void connectionParametersUpdated(struct bt_conn *conn, uint8_t err) {
	struct bt_conn_info info;
	err = bt_conn_get_info(conn, &info);
	if (err) {
		LOG_ERR("bt_conn_get_info failed (err %d)", err);
		return;
  }

	double connectionInterval = BT_GAP_US_TO_CONN_INTERVAL(info.le.interval_us) * 1.25; // in ms
	uint16_t supervisionTimeout = info.le.timeout * 10; // in ms
	LOG_INF("Connection parameters: interval %.2lf ms, latency %d intervals, timeout %d ms", connectionInterval, info.le.latency, supervisionTimeout);
}

void onLEdataLengthUpdated(struct bt_conn *conn, struct bt_conn_le_data_len_info *info) {
  uint16_t tx_len     = info->tx_max_len; 
  uint16_t tx_time    = info->tx_max_time;
  uint16_t rx_len     = info->rx_max_len;    
  uint16_t rx_time    = info->rx_max_time;
  
  LOG_INF("Data length updated. Length %d/%d bytes, time %d/%d us", tx_len, rx_len, tx_time, rx_time);
}

void onLEphyUpdated(struct bt_conn *conn, struct bt_conn_le_phy_info *param) {
  // PHY Updated
  if (param->tx_phy == BT_CONN_LE_TX_POWER_PHY_1M) {
    LOG_INF("PHY updated. New PHY: 1M");
  } else if (param->tx_phy == BT_CONN_LE_TX_POWER_PHY_2M) {
    LOG_INF("PHY updated. New PHY: 2M");
  } else if (param->tx_phy == BT_CONN_LE_TX_POWER_PHY_CODED_S8) {
    LOG_INF("PHY updated. New PHY: Long Range");  
  }
}

void updatePHY(struct bt_conn *conn) {
  const struct bt_conn_le_phy_param preferred_phy = {
    .options = BT_CONN_LE_PHY_OPT_NONE,
    .pref_rx_phy = BT_GAP_LE_PHY_2M,
    .pref_tx_phy = BT_GAP_LE_PHY_2M,  
  };
    
  int err = bt_conn_le_phy_update(conn, &preferred_phy);
  if (err) {
    LOG_ERR("bt_conn_le_phy_update() returned %d", err);  
  }
}

void updateDataLength(struct bt_conn *conn) {
  struct bt_conn_le_data_len_param my_data_len = {
    .tx_max_len = BT_GAP_DATA_LEN_MAX,
    .tx_max_time = BT_GAP_DATA_TIME_MAX,  
  };
    
  int err = bt_conn_le_data_len_update(conn, &my_data_len);
  if (err) {		  
    LOG_ERR("data_len_update failed (err %d)", err);
  }
}
```

## src/local_ble.h
```c
#ifndef BT_LOCAL_BLE
#define BT_LOCAL_BLE

#include <zephyr/types.h>
#include <zephyr/bluetooth/bluetooth.h>
#include <zephyr/bluetooth/hci.h>
#include <zephyr/bluetooth/conn.h>

void connectionParametersUpdated(struct bt_conn *conn, uint8_t err);

void onLEdataLengthUpdated(struct bt_conn *conn, struct bt_conn_le_data_len_info *info);

void onLEphyUpdated(struct bt_conn *conn, struct bt_conn_le_phy_info *param);

void updatePHY(struct bt_conn *conn);

void updateDataLength(struct bt_conn *conn);

#endif
```

## src/local_lbs.c
```c
#include <zephyr/types.h>
#include <stddef.h>
#include <string.h>
#include <errno.h>
#include <zephyr/sys/printk.h>
#include <zephyr/sys/byteorder.h>
#include <zephyr/kernel.h>
#include <zephyr/drivers/gpio.h>
#include <soc.h>

#include <zephyr/bluetooth/bluetooth.h>
#include <zephyr/bluetooth/hci.h>
#include <zephyr/bluetooth/conn.h>
#include <zephyr/bluetooth/uuid.h>
#include <zephyr/bluetooth/gatt.h>
#include <zephyr/bluetooth/gap.h>
#include <zephyr/logging/log.h>
#include <zephyr/bluetooth/addr.h>

#include <zephyr/settings/settings.h>
#include <dk_buttons_and_leds.h>

#include "local_lbs.h"

LOG_MODULE_DECLARE(Local_LBS);

static bool button_state;
static struct my_lbs_cb lbs_cb;

BT_GATT_SERVICE_DEFINE(my_lbs_svc, BT_GATT_PRIMARY_SERVICE(BT_UUID_LBS),

	BT_GATT_CHARACTERISTIC(BT_UUID_LBS_BUTTON, BT_GATT_CHRC_READ, BT_GATT_PERM_READ, read_button, NULL, &button_state),
		       
	BT_GATT_CHARACTERISTIC(BT_UUID_LBS_LED, BT_GATT_CHRC_WRITE, BT_GATT_PERM_WRITE, NULL, write_led, NULL),
);

static ssize_t read_button(struct bt_conn *conn,
			  const struct bt_gatt_attr *attr,
			  void *buf, uint16_t len, uint16_t offset) {
	//get a pointer to button_state which is passed in the BT_GATT_CHARACTERISTIC() and stored in attr->user_data
	const char *value = attr->user_data;

	LOG_INF("Attribute read, handle: %u, conn: %p", attr->handle, (void *)conn);

	if (lbs_cb.button_cb) {
		// Call the application callback function to update the get the current value of the button
		button_state = lbs_cb.button_cb();
		return bt_gatt_attr_read(conn, attr, buf, len, offset, value,
					 sizeof(*value));
	}

	return 0;
}

static ssize_t write_led(struct bt_conn *conn,
			 const struct bt_gatt_attr *attr,
			 const void *buf, uint16_t len, uint16_t offset, uint8_t flags) {
	LOG_INF("Attribute write, handle: %u, conn: %p", attr->handle,
		(void *)conn);

	if (len != 1U) {
		LOG_INF("Write led: Incorrect data length");
		return BT_GATT_ERR(BT_ATT_ERR_INVALID_ATTRIBUTE_LEN);
	}

	if (offset != 0) {
		LOG_INF("Write led: Incorrect data offset");
		return BT_GATT_ERR(BT_ATT_ERR_INVALID_OFFSET);
	}

	if (lbs_cb.led_cb) {
		//Read the received value 
		uint8_t val = *((uint8_t *)buf);

		if (val == 0x00 || val == 0x01) {
			//Call the application callback function to update the LED state
			lbs_cb.led_cb(val ? true : false);
		} else {
			LOG_INF("Write led: Incorrect value");
			return BT_GATT_ERR(BT_ATT_ERR_VALUE_NOT_ALLOWED);
		}
	}

	return len;
}

/* A function to register application callbacks for the LED and Button characteristics  */
int my_lbs_init(struct my_lbs_cb *callbacks) {
	
	if (callbacks) {
		lbs_cb.led_cb = callbacks->led_cb;
		lbs_cb.button_cb = callbacks->button_cb;
	}
	return 0;
}
```

## src/local_lbs.h
```c
#ifndef BT_LOCAL_LBS
#define BT_LOCAL_LBS

/** @brief LBS Service UUID. */
#define BT_UUID_LBS_VAL \
	BT_UUID_128_ENCODE(0x00001523, 0x1212, 0xefde, 0x1523, 0x785feabcd123)
	
/** @brief Button Characteristic UUID. */
#define BT_UUID_LBS_BUTTON_VAL \
	BT_UUID_128_ENCODE(0x00001524, 0x1212, 0xefde, 0x1523, 0x785feabcd123)
	
/** @brief LED Characteristic UUID. */
#define BT_UUID_LBS_LED_VAL \
  BT_UUID_128_ENCODE(0x00001525, 0x1212, 0xefde, 0x1523, 0x785feabcd123)

#define BT_UUID_LBS BT_UUID_DECLARE_128(BT_UUID_LBS_VAL)
#define BT_UUID_LBS_BUTTON BT_UUID_DECLARE_128(BT_UUID_LBS_BUTTON_VAL)
#define BT_UUID_LBS_LED BT_UUID_DECLARE_128(BT_UUID_LBS_LED_VAL)

/** @brief Callback type for when an LED state change is received. */
typedef void (*led_cb_t)(const bool led_state);

/** @brief Callback type for when the button state is pulled. */
typedef bool (*button_cb_t)(void);

/** @brief Callback struct used by the LBS Service. */
struct my_lbs_cb {
	/** LED state change callback. */
	led_cb_t led_cb;
	/** Button read callback. */
	button_cb_t button_cb;
};

static ssize_t read_button(struct bt_conn *conn,
			  const struct bt_gatt_attr *attr,
			  void *buf, uint16_t len, uint16_t offset);

static ssize_t write_led(struct bt_conn *conn,
			 const struct bt_gatt_attr *attr,
			 const void *buf, uint16_t len, uint16_t offset, uint8_t flags);

/** @brief Initialize the LBS Service.
 *
 * This function registers application callback functions with the My LBS
 * Service
 *
 * @param[in] callbacks Struct containing pointers to callback functions
 *			used by the service. This pointer can be NULL
 *			if no callback functions are defined.
 *
 *
 * @retval 0 If the operation was successful.
 *           Otherwise, a (negative) error code is returned.
 */
int my_lbs_init(struct my_lbs_cb *callbacks);

#endif
```

## src/my_function.c
```c
#include "my_function.h"
#include "local_lbs.h"

LOG_MODULE_DECLARE(MY_FUNCTION_H);

#define BT_UUID_PRI_SRC BT_UUID_128_ENCODE(0x6E400001, 0xB5A3, 0xF393, 0xE0A9, 0xE50E24DCCA9E)
#define BT_UUID_MY_SERVICE BT_UUID_DECLARE_128(BT_UUID_PRI_SRC)

// #define BT_UUID_HUE_SERV BT_UUID_128_ENCODE(0x57A70000, 0x9350, 0x11ED, 0xA1EB, 0x0242AC120002)
// #define BT_UUID_SECONDARY_HUE_SERVICE BT_UUID_DECLARE_128(BT_UUID_HUE_SERV)

#define BT_UUID_LED_VAL BT_UUID_128_ENCODE(0x00001525, 0x1212, 0xefde, 0x1523, 0x785feabcd123)
#define BT_UUID_LED_CHAR BT_UUID_DECLARE_128(BT_UUID_LED_VAL)

#define CUSTOM_READ_VALUE_CHAR_UUID 0x1401
#define CUSTOM_SECOND_VALUE_CHAR_UUID 0x1402

#define BT_UUID_SEC_VAL BT_UUID_128_ENCODE(0x932C32BD, 0x0002, 0x47A2, 0x835A, 0xA8D455B859DD)
#define BT_UUID_SEC_CHAR BT_UUID_DECLARE_128(BT_UUID_SEC_VAL)

static bool read_state;

static int primaryState;
static int secondaryState;
static int includedServiceCharacteristicState;
static int includedServiceSecondCharacteristicState;

static struct secondary_service_cb secondary_cb;

static ssize_t readSecondaryState(struct bt_conn *conn, const struct bt_gatt_attr *attr, void *buf, uint16_t len, uint16_t offset) {
    const char *value = attr->user_data;
	
	if (secondary_cb.sec_cb) {
        secondaryState = secondary_cb.sec_cb();
        LOG_INF("[READ] Secondary Attribute: handle: %u, conn: %p, value %d", attr->handle, (void *)conn, secondaryState);
        return bt_gatt_attr_read(conn, attr, buf, len, offset, (void *)secondaryState, sizeof(secondaryState));
    }
    return 0;
}

static ssize_t readPrimaryState(struct bt_conn *conn, const struct bt_gatt_attr *attr, void *buf, uint16_t len, uint16_t offset) {
    const char *value = attr->user_data;

    if (secondary_cb.sec_cb) {
        primaryState++;
        LOG_INF("[READ] Primary Attribute: handle: %u, conn: %p, value %d", attr->handle, (void *)conn, primaryState);
        return bt_gatt_attr_read(conn, attr, buf, len, offset, value, sizeof(*value));
    }
	return 0;
}

static ssize_t readIncludedServiceCharacteristic(struct bt_conn *conn, const struct bt_gatt_attr *attr, void *buf, uint16_t len, uint16_t offset) {
    const char *value = attr->user_data;

    includedServiceCharacteristicState++;
    LOG_INF("[READ] Included Service Attribute: handle: %u, conn: %p, value %d", attr->handle, (void *)conn, includedServiceCharacteristicState);
    return bt_gatt_attr_read(conn, attr, buf, len, offset, value, sizeof(*value));
}

static ssize_t readSecondIncludedServiceCharacteristic(struct bt_conn *conn, const struct bt_gatt_attr *attr, void *buf, uint16_t len, uint16_t offset) {
    const char *value = attr->user_data;
    includedServiceSecondCharacteristicState++;
    LOG_INF("[READ] Included Service (Second) Attribute: handle: %u, conn: %p, value %d", attr->handle, (void *)conn, includedServiceSecondCharacteristicState);
    return bt_gatt_attr_read(conn, attr, buf, len, offset, value, sizeof(*value));
}

static ssize_t writeSecondIncludedServiceCharacteristic(struct bt_conn *conn, const struct bt_gatt_attr *attr, const void *buf, uint16_t len, uint16_t offset, uint8_t flags) {
	if (len != 1U) {
		LOG_INF("Write led: Incorrect data length");
		return BT_GATT_ERR(BT_ATT_ERR_INVALID_ATTRIBUTE_LEN);
	}

	if (offset != 0) {
		LOG_INF("Write led: Incorrect data offset");
		return BT_GATT_ERR(BT_ATT_ERR_INVALID_OFFSET);
	}
    
    // Read the received value 
	uint8_t val = *((uint8_t *)buf);
    LOG_INF("[WRITE] Included Service (Second) Attribute: handle: %u, conn: %p, value %d", attr->handle, (void *)conn, val);
    includedServiceSecondCharacteristicState = val;
	return len;
}

static ssize_t read_button(struct bt_conn *conn, const struct bt_gatt_attr *attr, void *buf, uint16_t len, uint16_t offset) {
    const char *value = attr->user_data;
	LOG_INF("Attribute read, handle: %u, conn: %p", attr->handle, (void *)conn);
    return 0;
}

BT_GATT_SERVICE_DEFINE(secondary_service, BT_GATT_SECONDARY_SERVICE(BT_UUID_LBS),

    BT_GATT_CHARACTERISTIC(BT_UUID_SEC_CHAR, BT_GATT_CHRC_READ, BT_GATT_PERM_READ, readIncludedServiceCharacteristic, NULL, &includedServiceCharacteristicState),

    BT_GATT_CHARACTERISTIC(BT_UUID_LED_CHAR, BT_GATT_CHRC_READ | BT_GATT_CHRC_WRITE, BT_GATT_PERM_READ | BT_GATT_PERM_WRITE, readSecondIncludedServiceCharacteristic, writeSecondIncludedServiceCharacteristic, &includedServiceSecondCharacteristicState),
);

BT_GATT_SERVICE_DEFINE(my_service, BT_GATT_PRIMARY_SERVICE(BT_UUID_MY_SERVICE),

    BT_GATT_INCLUDE_SERVICE(&secondary_service.attrs[0]),

    BT_GATT_CHARACTERISTIC(CUSTOM_READ_VALUE_CHAR_UUID, BT_GATT_CHRC_READ, BT_GATT_PERM_READ, readPrimaryState, NULL, &primaryState),
		       
    BT_GATT_CHARACTERISTIC(BT_UUID_LED_CHAR, BT_GATT_CHRC_READ, BT_GATT_PERM_READ, read_button, NULL, &read_state),
);

// BT_GATT_SERVICE_DEFINE(ess_svc, BT_GATT_PRIMARY_SERVICE(BT_UUID_ESS),

// 	/* Temperature Sensor 1 */
// 	BT_GATT_CHARACTERISTIC(BT_UUID_TEMPERATURE,
// 			       BT_GATT_CHRC_READ | BT_GATT_CHRC_NOTIFY,
// 			       BT_GATT_PERM_READ,
// 			       read_u16, NULL, &sensor_1.temp_value),
// 	BT_GATT_DESCRIPTOR(BT_UUID_ES_MEASUREMENT, BT_GATT_PERM_READ,
// 			   read_es_measurement, NULL, &sensor_1.meas),
// 	BT_GATT_CUD(SENSOR_1_NAME, BT_GATT_PERM_READ),
// 	BT_GATT_DESCRIPTOR(BT_UUID_VALID_RANGE, BT_GATT_PERM_READ,
// 			   read_temp_valid_range, NULL, &sensor_1),
// 	BT_GATT_DESCRIPTOR(BT_UUID_ES_TRIGGER_SETTING,
// 			   BT_GATT_PERM_READ, read_temp_trigger_setting,
// 			   NULL, &sensor_1),
// 	BT_GATT_CCC(temp_ccc_cfg_changed,
// 		    BT_GATT_PERM_READ | BT_GATT_PERM_WRITE),

// 	/* Temperature Sensor 2 */
// 	BT_GATT_CHARACTERISTIC(BT_UUID_TEMPERATURE,
// 			       BT_GATT_CHRC_READ | BT_GATT_CHRC_NOTIFY,
// 			       BT_GATT_PERM_READ,
// 			       read_u16, NULL, &sensor_2.temp_value),
// 	BT_GATT_DESCRIPTOR(BT_UUID_ES_MEASUREMENT, BT_GATT_PERM_READ,
// 			   read_es_measurement, NULL, &sensor_2.meas),
// 	BT_GATT_CUD(SENSOR_2_NAME, BT_GATT_PERM_READ),
// 	BT_GATT_DESCRIPTOR(BT_UUID_VALID_RANGE, BT_GATT_PERM_READ,
// 			   read_temp_valid_range, NULL, &sensor_2),
// 	BT_GATT_DESCRIPTOR(BT_UUID_ES_TRIGGER_SETTING,
// 			   BT_GATT_PERM_READ, read_temp_trigger_setting,
// 			   NULL, &sensor_2),
// 	BT_GATT_CCC(temp_ccc_cfg_changed,
// 		    BT_GATT_PERM_READ | BT_GATT_PERM_WRITE),

// 	/* Humidity Sensor */
// 	BT_GATT_CHARACTERISTIC(BT_UUID_HUMIDITY, BT_GATT_CHRC_READ,
// 			       BT_GATT_PERM_READ,
// 			       read_u16, NULL, &sensor_3.humid_value),
// 	BT_GATT_CUD(SENSOR_3_NAME, BT_GATT_PERM_READ),
// 	BT_GATT_DESCRIPTOR(BT_UUID_ES_MEASUREMENT, BT_GATT_PERM_READ,
// 			   read_es_measurement, NULL, &sensor_3.meas),
// );

// static ssize_t write_led(struct bt_conn *conn,
// 			 const struct bt_gatt_attr *attr,
// 			 const void *buf, uint16_t len, uint16_t offset, uint8_t flags) {
// 	LOG_INF("Attribute write, handle: %u, conn: %p", attr->handle,
// 		(void *)conn);

// 	if (len != 1U) {
// 		LOG_INF("Write led: Incorrect data length");
// 		return BT_GATT_ERR(BT_ATT_ERR_INVALID_ATTRIBUTE_LEN);
// 	}

// 	if (offset != 0) {
// 		LOG_INF("Write led: Incorrect data offset");
// 		return BT_GATT_ERR(BT_ATT_ERR_INVALID_OFFSET);
// 	}

// 	if (lbs_cb.led_cb) {
// 		//Read the received value 
// 		uint8_t val = *((uint8_t *)buf);

// 		if (val == 0x00 || val == 0x01) {
// 			//Call the application callback function to update the LED state
// 			lbs_cb.led_cb(val ? true : false);
// 		} else {
// 			LOG_INF("Write led: Incorrect value");
// 			return BT_GATT_ERR(BT_ATT_ERR_VALUE_NOT_ALLOWED);
// 		}
// 	}

// 	return len;
// }

// /* A function to register application callbacks for the LED and Button characteristics  */
// int my_lbs_init(struct my_lbs_cb *callbacks) {
// 	if (callbacks) {
// 		lbs_cb.led_cb = callbacks->led_cb;
// 		lbs_cb.button_cb = callbacks->button_cb;
// 	}

// 	return 0;
// }

uint32_t ble_sec_init(struct secondary_service_cb *callbacks) {
    if (callbacks) {
        secondary_cb.sec_cb = callbacks->sec_cb;
    }
    return 0;
}
```

## src/my_function.h
```c
#ifndef MY_FUNCTION_H
#define MY_FUNCTION_H

#include <zephyr/types.h>
#include <stddef.h>
#include <string.h>
#include <errno.h>
#include <zephyr/sys/printk.h>
#include <zephyr/sys/byteorder.h>
#include <zephyr/kernel.h>
#include <zephyr/drivers/gpio.h>
#include <soc.h>

#include <zephyr/bluetooth/bluetooth.h>
#include <zephyr/bluetooth/hci.h>
#include <zephyr/bluetooth/conn.h>
#include <zephyr/bluetooth/uuid.h>
#include <zephyr/bluetooth/gatt.h>
#include <zephyr/bluetooth/gap.h>
#include <zephyr/logging/log.h>
#include <zephyr/bluetooth/addr.h>
#include <zephyr/settings/settings.h>

/** @brief Callback type for when the button state is pulled. */
typedef int (*sec_cb_t)(void);

/** @brief Callback struct used by the LBS Service. */
struct secondary_service_cb {
	
	/** Read callback. */
	sec_cb_t sec_cb;
};

/** @brief Callback type for when the button state is pulled. */
// typedef int (*sec_cb_t)(void);

typedef void (*secondary_cb_t)(const uint8_t secondary_state);

/**@brief Function for initializing the Custom Service.
 *
 * @return      NRF_SUCCESS on successful initialization of service, otherwise an error code.
 */
uint32_t ble_sec_init(struct secondary_service_cb *callbacks);

#endif
```
